## 04_SPI_basics/lab/dts/bindings/spi/zds,spi-loopback.yaml
```yaml
description: Generic placeholder SPI device node, used for a bus-level loopback self-test

compatible: "zds,spi-loopback"

include: spi-device.yaml
```

## 04_SPI_basics/lab/sample.yaml
```yaml
sample:
  name: SPI basics - bus loopback self-test
  description: >
    Verify the SPI2 (GPSPI2) peripheral, clock, and pin routing on the
    ESP32-S3-DevKitC-1 using a devicetree-level loopback (MISO and MOSI
    mapped to the same GPIO pad) - no jumper wire and no real SPI device
    required.
common:
  tags:
    - spi
  platform_allow:
    - esp32s3_devkitc/esp32s3/procpu
  harness: console
  harness_config:
    type: one_line
    regex:
      - "PASS: received bytes match sent bytes.*"
tests:
  sample.spi.esp32s3_loopback:
    build_only: true
```

## 07_Nokia5110_display/lab/dts/bindings/display/zds,pcd8544.yaml
```yaml
description: |
  PCD8544-based Nokia 5110 monochrome LCD (84x48), driven over raw SPI
  from application code - no Zephyr Display/CFB subsystem involved.

compatible: "zds,pcd8544"

include: spi-device.yaml

properties:
  reset-gpios:
    type: phandle-array
    required: true
    description: >
      Reset pin. Active low - pulse low to reset the PCD8544 controller.

  dc-gpios:
    type: phandle-array
    required: true
    description: >
      Data/Command select pin. Driven low before a command byte is
      written, high before a data byte is written. (Property name
      matches the convention used by Zephyr's own mipi-dbi-spi
      display binding.)
```

## 07_Nokia5110_display/lab/sample.yaml
```yaml
sample:
  name: Nokia 5110 (PCD8544) LCD - raw SPI
  description: >
    Drive an 84x48 PCD8544-based Nokia 5110 monochrome LCD over raw SPI
    (MOSI/SCLK/CS + separate RST/DC GPIOs), without the Zephyr
    Display/CFB subsystem.
common:
  tags:
    - spi
    - display
  platform_allow:
    - esp32s3_devkitc/esp32s3/procpu
  harness: console
  harness_config:
    type: one_line
    regex:
      - "Nokia 5110 initialized and .* written"
tests:
  sample.spi.nokia5110_pcd8544:
    build_only: true
```

## 08_TFT_ST7735/lab/dts/bindings/display/zds,st7735.yaml
```yaml
description: |
  ST7735-based 128x160 color TFT ("green tab" variant), driven over raw
  SPI from application code - no Zephyr Display/CFB subsystem involved.

compatible: "zds,st7735"

include: spi-device.yaml

properties:
  reset-gpios:
    type: phandle-array
    required: true
    description: >
      Reset pin. Active low - pulse low to reset the ST7735 controller.

  dc-gpios:
    type: phandle-array
    required: true
    description: >
      Data/Command select pin. Driven low before a command byte is
      written, high before a data byte is written. (Property name
      matches the convention used by Zephyr's own mipi-dbi-spi
      display binding, and the zds,pcd8544 binding from Lab 07.)
```
